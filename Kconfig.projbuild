## Kconfig.projbuild
```kconfig
menu "Component app_socket_stdio Configuration"

    config APP_SOCKET_STDIO_USE
        bool "Use app socket stdio  (application socket stdio)"
        default y
    
endmenu
```
